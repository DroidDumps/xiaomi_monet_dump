/dts-v1/;

/ {
	compatible = "qcom,lagoon-rumi\0qcom,lagoon\0qcom,rumi";
	model = "Qualcomm Technologies, Inc. Lagoon RUMI";
	qcom,board-id = <0x0f 0x00>;
	qcom,msm-id = <0x1b2 0x10000>;

	__fixups__ {
		L12A = "/fragment@2/__overlay__:vccq2-supply:0\0/fragment@7/__overlay__:vdd-io-supply:0";
		L18A = "/fragment@1/__overlay__:vdda-phy-supply:0";
		L22A = "/fragment@1/__overlay__:vdda-pll-supply:0\0/fragment@2/__overlay__:qcom,vddp-ref-clk-supply:0";
		L6E = "/fragment@8/__overlay__:vdd-io-supply:0";
		L7E = "/fragment@2/__overlay__:vcc-supply:0\0/fragment@7/__overlay__:vdd-supply:0";
		L9E = "/fragment@8/__overlay__:vdd-supply:0";
		aopcc = "/fragment@6:target:0";
		gcc_ufs_phy_gdsc = "/fragment@2/__overlay__:vdd-hba-supply:0";
		qupv3_se10_i2c = "/fragment@9:target:0";
		qupv3_se9_2uart = "/fragment@10:target:0";
		rpmhcc = "/fragment@5:target:0";
		sdc1_clk_off = "/fragment@7/__overlay__:pinctrl-1:0";
		sdc1_clk_on = "/fragment@7/__overlay__:pinctrl-0:0";
		sdc1_cmd_off = "/fragment@7/__overlay__:pinctrl-1:4";
		sdc1_cmd_on = "/fragment@7/__overlay__:pinctrl-0:4";
		sdc1_data_off = "/fragment@7/__overlay__:pinctrl-1:8";
		sdc1_data_on = "/fragment@7/__overlay__:pinctrl-0:8";
		sdc1_rclk_off = "/fragment@7/__overlay__:pinctrl-1:12";
		sdc1_rclk_on = "/fragment@7/__overlay__:pinctrl-0:12";
		sdc2_clk_off = "/fragment@8/__overlay__:pinctrl-1:0";
		sdc2_clk_on = "/fragment@8/__overlay__:pinctrl-0:0";
		sdc2_cmd_off = "/fragment@8/__overlay__:pinctrl-1:4";
		sdc2_cmd_on = "/fragment@8/__overlay__:pinctrl-0:4";
		sdc2_data_off = "/fragment@8/__overlay__:pinctrl-1:8";
		sdc2_data_on = "/fragment@8/__overlay__:pinctrl-0:8";
		sdhc_1 = "/fragment@7:target:0";
		sdhc_2 = "/fragment@8:target:0";
		soc = "/fragment@0:target:0";
		ufshc_mem = "/fragment@2:target:0";
		ufsphy_mem = "/fragment@1:target:0";
		usb0 = "/fragment@4:target:0";
		usb_nop_phy = "/fragment@4/__overlay__/dwc3@a600000:usb-phy:4";
		wdog = "/fragment@3:target:0";
		xo_board = "/fragment@0/__overlay__/bi_tcxo:clocks:0\0/fragment@0/__overlay__/bi_tcxo_ao:clocks:0";
	};

	__local_fixups__ {

		fragment@4 {

			__overlay__ {

				dwc3@a600000 {
					usb-phy = <0x00>;
				};
			};
		};
	};

	__symbols__ {
		bi_tcxo = "/fragment@0/__overlay__/bi_tcxo";
		bi_tcxo_ao = "/fragment@0/__overlay__/bi_tcxo_ao";
		usb_emu_phy = "/fragment@0/__overlay__/usb_emu_phy@a720000";
	};

	fragment@0 {
		target = <0xffffffff>;

		__overlay__ {

			bi_tcxo {
				#clock-cells = <0x00>;
				clock-div = <0x04>;
				clock-mult = <0x01>;
				clocks = <0xffffffff>;
				compatible = "fixed-factor-clock";
				phandle = <0x02>;
			};

			bi_tcxo_ao {
				#clock-cells = <0x00>;
				clock-div = <0x04>;
				clock-mult = <0x01>;
				clocks = <0xffffffff>;
				compatible = "fixed-factor-clock";
				phandle = <0x03>;
			};

			timer {
				clock-frequency = <0x7a120>;
			};

			timer@17c20000 {
				clock-frequency = <0x7a120>;
			};

			usb_emu_phy@a720000 {
				compatible = "qcom,usb-emu-phy";
				phandle = <0x01>;
				qcom,emu-init-seq = <0xfff0 0x04 0xfff3 0x04 0x40 0x04 0xfff3 0x04 0xfff0 0x04 0x100000 0x20 0x00 0x20 0x1a0 0x20 0x100000 0x3c 0x00 0x3c 0x10060 0x3c 0x00 0x04>;
				reg = <0xa720000 0x9500 0xa6f8800 0x100>;
				reg-names = "base\0qscratch_base";
			};
		};
	};

	fragment@1 {
		target = <0xffffffff>;

		__overlay__ {
			compatible = "qcom,ufs-phy-qrbtc-sdm845";
			status = "ok";
			vdda-phy-max-microamp = <0xf5b4>;
			vdda-phy-supply = <0xffffffff>;
			vdda-pll-max-microamp = <0x477c>;
			vdda-pll-supply = <0xffffffff>;
		};
	};

	fragment@10 {
		target = <0xffffffff>;

		__overlay__ {
			qcom,rumi_platform;
		};
	};

	fragment@2 {
		target = <0xffffffff>;

		__overlay__ {
			limit-rx-hs-gear = <0x01>;
			limit-tx-hs-gear = <0x01>;
			qcom,disable-lpm;
			qcom,vddp-ref-clk-max-microamp = <0x64>;
			qcom,vddp-ref-clk-supply = <0xffffffff>;
			scsi-cmd-timeout = <0x493e0>;
			status = "ok";
			vcc-max-microamp = "\0\f5";
			vcc-supply = <0xffffffff>;
			vccq2-max-microamp = "\0\f5";
			vccq2-supply = <0xffffffff>;
			vdd-hba-fixed-regulator;
			vdd-hba-supply = <0xffffffff>;
		};
	};

	fragment@3 {
		target = <0xffffffff>;

		__overlay__ {
			status = "disabled";
		};
	};

	fragment@4 {
		target = <0xffffffff>;

		__overlay__ {

			dwc3@a600000 {
				maximum-speed = "high-speed";
				usb-phy = <0x01 0xffffffff>;
			};
		};
	};

	fragment@5 {
		target = <0xffffffff>;

		__overlay__ {
			clock-output-names = "rpmh_clocks";
			compatible = "qcom,dummycc";
		};
	};

	fragment@6 {
		target = <0xffffffff>;

		__overlay__ {
			clock-output-names = "qdss_clocks";
			compatible = "qcom,dummycc";
		};
	};

	fragment@7 {
		target = <0xffffffff>;

		__overlay__ {
			pinctrl-0 = <0xffffffff 0xffffffff 0xffffffff 0xffffffff>;
			pinctrl-1 = <0xffffffff 0xffffffff 0xffffffff 0xffffffff>;
			pinctrl-names = "active\0sleep";
			qcom,bus-speed-mode = "DDR_1p8v";
			qcom,clk-rates = <0x61a80 0x17d7840 0x2faf080>;
			qcom,vdd-current-level = <0x00 0x8b290>;
			qcom,vdd-io-always-on;
			qcom,vdd-io-current-level = <0x00 0x4f588>;
			qcom,vdd-io-lpm-sup;
			qcom,vdd-io-voltage-level = <0x1b7740 0x1b7740>;
			qcom,vdd-voltage-level = <0x2d2a80 0x2d2a80>;
			status = "ok";
			vdd-io-supply = <0xffffffff>;
			vdd-supply = <0xffffffff>;
		};
	};

	fragment@8 {
		target = <0xffffffff>;

		__overlay__ {
			pinctrl-0 = <0xffffffff 0xffffffff 0xffffffff>;
			pinctrl-1 = <0xffffffff 0xffffffff 0xffffffff>;
			pinctrl-names = "active\0sleep";
			qcom,bus-speed-mode = "SDR12\0SDR25\0SDR50";
			qcom,clk-rates = <0x61a80 0x17d7840 0x2faf080>;
			qcom,vdd-current-level = <0x00 0xc3500>;
			qcom,vdd-io-current-level = <0x00 0x55f0>;
			qcom,vdd-io-voltage-level = <0x1b7740 0x2d0370>;
			qcom,vdd-voltage-level = <0x2d2a80 0x2d2a80>;
			status = "ok";
			vdd-io-supply = <0xffffffff>;
			vdd-supply = <0xffffffff>;
		};
	};

	fragment@9 {
		target = <0xffffffff>;

		__overlay__ {
			status = "disabled";
		};
	};
};
